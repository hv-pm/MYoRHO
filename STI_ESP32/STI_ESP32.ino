//-----------------------------------------------------------------------------CABEÇALHO-----------------------------------------------------------------------------
// Autor: Hygor Vinícius Pereira Martins (2022)
//        ESP32_STI ()
//
// Arduino IDE v1.8.1
//
// Bibliotecas utilizadas:
//                        BLEDevice (https://github.com/espressif/arduino-esp32/blob/master/libraries/BLE/src/BLEDevice.h)
//                        BLEUtils (https://github.com/espressif/arduino-esp32/blob/master/libraries/BLE/src/BLEUtils.h)
//                        BLEServer (https://github.com/espressif/arduino-esp32/blob/master/libraries/BLE/src/BLEServer.h)
// Código auxiliar:
//                 Look-up table (https://github.com/e-tinkers/esp32-adc-calibrate/blob/master/examples/esp32_adc_lut_example.ino)
//
// Adaptado de:
//             BLE server (https://github.com/nkolban/esp32-snippets/blob/master/cpp_utils/tests/BLETests/SampleServer.cpp)

//----------------------------------------------------------------------------BIBLIOTECAS----------------------------------------------------------------------------
#include <BLEDevice.h> // Permite uso dos comandos do bluetooth de baixa energia da plataforma ESP32.
#include <BLEUtils.h> // Utilitários para envio dos dados por BLE em diversos formatos.
#include <BLEServer.h> // Habilita as operações envolvendo o servidor BLE criado no ESP32.

//------------------------------------------------------------------------------FILTROS------------------------------------------------------------------------------
//--------------------------------BUTTERWORTH-------------------------------
// Filtro passa-banda (passa-alta + passa-baixa) de 4ª ordem para a faixa de frequência 20 à 200 Hz. é implmentada no ESP32 utilizando a transposta da forma direta II da equação:
//    a(1)*y(n) = b(1)*x(n) + b(2)*x(n-1) + ... + b(nb+1)*x( ) - a(2)*y(n-1) - ... a(na+1)*y(n-na)
// onde,
// a = vetor descritor do tipo de filtro (denominador);
// b = vetor descritor do tipo de filtro (numerador);
// x = vetor de amostra a ser filtrado;
// y = vetor da amostra filtrada;
// n = índice da amostra dentro da janela de SMEs.
// Os vetores descritores do filtro tem tamanho de N+1, onde N é o número da ordem do filtro, i.e. para um filtro 4ª ordem, N = 4.

// A transposta da forma direta II implementada no ESP32 é:
//------------Passa-alta------------
//    Ya = Ba(1)*x(t) + Ba(2)*x(t-1) + Ba(3)*x(t-2) + Ba(4)*x(t-3) + Ba(5)*x(t-4) - Aa(2)*Ya(t-1) - Aa(3)*Ya(n-2) - Aa(4)*Ya(n-3) - Aa(5)*Ya(n-4)
// onde,
// Aa = vetor descritor do filtro passa-alta (denominador);
// Ba = vetor descritor do filtro passa-alta (numerador);
// x = vetor de amostra a ser filtrado no passa-alta;
// Ya = vetor da amostra filtrada no passa-alta;
// t = índice da amostra dentro da janela de SMEs;
// n = índice da amostra dentro da janela de SMEs filtrados pelo passa-alta.

//------------Passa-baixa------------
//    Yb = Bb(1)*Ya(n) + Bb(2)*Ya(n-1) + Bb(3)*Ya(n-2) + Bb(4)*Ya(n-3) + Bb(5)*Ya(n-4) - Ab(2)*Yb(n-1) - Ab(3)*Yb(n-2) - Ab(4)*Yb(n-3) - Ab(5)*Yb(n-4)
// onde,
// Ab = vetor descritor do filtro passa-baixa (denominador);
// Bb = vetor descritor do filtro passa-baixa (numerador);
// Ya = vetor de amostra filtrada no passa-alta a ser filtrado no passa-baixa;
// Yb = vetor da amostra filtrada no passa-alta e depois no passa-baixa (passa-banda);
// t = índice da amostra dentro da janela de SMEs filtrados pelo passa-alta;
// n = índice da amostra dentro da janela de SMEs filtrados pelo passa-baixa.

// Utilizar o arquivo "filter_num_den_gen.m" para gerar os vetores descritivos Butterworth de 4ª ordem:
//  - Numeradores Ba, Bb (butterworth);
//  - Denominadores Aa, Ab (butterworth).
//------>Passa-alta[Aa,Ba] Passa-baixa[Ab,Bb]
const double Aa[5] = {1, -3.671729089161938, 5.067998386734198, -3.115966925201753, 0.719910327291874};
const double Ba[5] = {0.848475295524360, -3.393901182097441, 5.090851773146162, -3.393901182097441, 0.848475295524360};
const double Ab[5] = {1, -0.782095198023338, 0.679978526916299, -0.182675697753032, 0.030118875043169};
const double Bb[5] = {0.046582906636444, 0.186331626545775, 0.279497439818662, 0.186331626545775, 0.046582906636444};

//--------------------------VARIÁVEIS BUTTERWORTH--------------------------
double x[80]; // Janela de 80 ms dos SMEs lidos pelo MyoWare, cada amostra é coletada à 1 kHz.
double x_t1; // x(n-1).
double x_t2; // x(n-2).
double x_t3; // x(n-3).
double x_t4; // x(n-4).
double Ya[5]; // Janela móvel para filtrar x com filtro Butterworth 4ª ordem (passa-alta).
double Yb[5]; // Janela móvel para filtrar Ya com filtro Butterworth 4ª ordem (passa-baixa).
int t = 0; // Índice da janela de SMEs lidos pelo MyoWare.

//------------------------VARIÁVEIS DE CONTINUIDADE------------------------
// Como os filtros utilizados são recursivos, eles utilizam valores de saída anteriores.
// Estas variáveis guardam os últimos valores da janela anterior para serem usados na nova janela.
// Quando o STI inicia, não há amostras. Assim, a extração de características e classificação da primeira janela de 80 ms será errônea.
// Na segunda filtragem já ocorre a estabilização. Isso não afeta o STI de qualquer forma, pois o SRA é programado para se conectar ao SRI depois de alguns segundos.
double x_ant; // x(n) da janela anterior.
double x_t1_ant; // x(n-1) da janela anterior.
double x_t2_ant; // x(n-2) da janela anterior.
double x_t3_ant; // x(n-3) da janela anterior.
double Ya_ant; // Ya(n) da janela filtrada anterior.
double Ya_n1_ant; // Ya(n-1) da janela filtrada anterior.
double Ya_n2_ant; // Ya(n-2) da janela filtrada anterior.
double Ya_n3_ant; // Ya(n-3) da janela filtrada anterior.
double Yb_ant; // Yb(n) da janela filtrada anterior.
double Yb_n1_ant; // Yb(n-1) da janela filtrada anterior.
double Yb_n2_ant; // Yb(n-2) da janela filtrada anterior.
double Yb_n3_ant; // Yb(n-3) da janela filtrada anterior.
bool bn_ant = false; // Variável auxiliar no translado dos dados da janela filtrada anterior para a atual. Ativa (true) ou desativa (false) o método de deslocamento da janela dos filtros.
int bn_cont = 0; // Variável auxiliar no translado dos dados da janela filtrada anterior para a atual. Conta quantas vezes a janela de dados filtrados deslocou em uma unidade os dados filtrados anteriores na janela de filtro atual.

//----------------------------------NOTCH----------------------------------
// Filtro Notch para a frequência de rede (60 Hz). Também é implmentada no ESP32 utilizando a transposta da forma direta II:
//    Yn = Bn(1)*Yb(n) + Bn(2)*Yb(n-1) + Bn(3)*Yb(n-2) - An(2)*Yc(n-1) - An(3)*Yc(n-2)
// onde,
// Ab = vetor descritor do filtro Notch (denominador);
// Bb = vetor descritor do filtro Notch (numerador);
// Yb = vetor de amostra filtrada no passa-banda a ser filtrado no Notch;
// Yc = vetor da amostra filtrada no passa-banda e no Notch (60 Hz);
// n = índice da amostra dentro da janela de SMEs.

//Utilizar o arquivo "filter_num_den_gen.m" (github) para gerar os vetores:
//  - Numeradores Bn (notch);
//  - Denominadores An (notch).
//------>[An,Bn]
const double An[3] = {1, -1.856054387535818, 0.996237177113225};
const double Bn[3] = {0.998118588556613, -1.856054387535818, 0.998118588556613};

//-----------------------------VARIÁVEIS NOTCH-----------------------------
double Yc[80]; // Guarda os SMEs filtrados pelo Notch.
double Yc_n1; // Yc(n-1).
double Yc_n2; // Yc(n-2).
int n = 0; // Índice da janela de SMEs filtrados.

//------------------------VARIÁVEIS DE CONTINUIDADE------------------------
int flag_reset = 0; // Durante a filtragem pelo filtro Notch na janela de 80 ms, o vetor Yc rebece um reset no índice n após um determinado valor, isso é necessário para simplificar o processo de filtragem.
// flag_reset = 0 -> Não há necessidade de resetar o índice do vetor Yc ainda, continue usando os recursos dos índices anteriores. Possui algumas condições para STI caso seja a primeira vez rodando o filtro após o início.
// flag_reset = 1 -> Houve o reset do índice n, ativa rotina para utilizar os dados do fim do vetor como recursos de entrada no filtro.
// flag_reset = 2 -> Continua o processo da rotina de flag = 1, faz o intermédio entre o outro recurso do fim do vetor e dá continuidade no índice do vetor atual.
double Yc_n1_reset; // Guarda os recursos de Yc[n-1] antes de resetar o índice, i.e., Yc[4].
double Yc_n2_reset; // Guarda os recursos de Yc[n-2] antes de resetar o índice, i.e., Yc[3].
double Yc_ant; // Yc[n] da janela filtrada anterior.
double Yc_n1_ant; // Yb[n-1] da janela filtrada anterior.

//------------------------------------------------------------------VARIÁVEIS PARA AS CARACTERÍSTICAS-----------------------------------------------------------------
// Este espaço pode ser usado para criar as variáveis das características que serão implementadas para seu projeto.
// Neste programa, dois contadores criados para realizar a soma das amostras. Esses somatórios são utilizados nas equações de extração das características posteriormente.
double rms_sum = 0;
double dasdv_sum = 0;
double dasdv_aux = 0;

//---------------------------------------------------------------------------PARÂMETROS LDA---------------------------------------------------------------------------
// Quando o número de amostras usadas no treinamento do LDA para cada classe é o mesmo, a probabilidade a priori é redundante e é descartada da equação de predição.
// Dessa forma, apenas a fórmula da distância Mahalanobis é utilizada para discriminar uma amostra desconhecida x.
// A distância Mahalanobis é adistância entre x e o centro de cada classe. O centro da classe mais próximo de x tem a maior chance de x pertencer à tal classe.
// Como o LDA foi treinado com o mesmo número de amostras para cada classe, será implementada apenas a distância Mahalanobis para discriminação das características extraídas dos SMEs em tempo real.
// A equação de Mahalanobis irá gerar uma matriz (Dis_Mah) 3x3, e a distância das características extraídas até o centro das classes serão representadas na diagonal principal.
//    Dis_Mah = (x - m) * S^-1 * (x - m)'
// onde,
// x = vetor de características que é extraído após a filtragem dos SMEs;
// m = matriz de média das classes;
// S = matriz de covariancia entre classes;
// Dis_Mah[1][1] = distância Mahalanobis do vetor de características processados em tempo real até o centro da classe MR (Mão em Repouso);
// Dis_Mah[2][2] = distância Mahalanobis do vetor de características processados em tempo real até o centro da classe PP (Preensão Pinça);
// Dis_Mah[3][3] = distância Mahalanobis do vetor de características processados em tempo real até o centro da classe PC (Preensão Cilíndrica);
// o vetor y irá guardar apenas as distâncias e a matriz será descartada.
// y = [LDA[1][1], LDA[2][2], LDA[3][3]];

double x_carac[1][2]; // Guarda as duas características no vetor a ser discriminado.
double x_m_Sinv[3][3]; // Guarda a parte "(x - m) * S^-1" da equação Mahalanobis.
double y[1][3]; // Guarda as distâncias Mahalanobis para as classes MR, PP e PC.

//Utilizar o arquivo ".m" (github) para gerar as matrizes:
//  - De média das classes (Mdl.Mu);
//  - De covariancia entre classes (Mdl.Sigma).
double m[3][2] = {
  {0.0422393511058094,  0.0267576253325455},
  {0.143745116387683, 0.0812458071679230},
  {0.228088290837087, 0.122776872573675}
};

double Sinv[2][2] = {
  {6.416741256726920e+04, -1.148893014853887e+05},
  {-1.148893014853887e+05, 2.090185861335545e+05}
};

//---------------------------------------------------------------------------LOOK-UP TABLE---------------------------------------------------------------------------
// A LUT é gerada a partir do exemplo "esp32_adc_lut_example" disponível no header deste código.
const float ADC_LUT[4096] = { 0,
                              72.4000, 80.8000, 81.8000, 82.8000, 84.0000, 85.0000, 86.0000, 87.0000, 88.0000, 89.2000, 90.2000, 91.4000, 92.6000, 93.6000, 94.8000,
                              95.8000, 96.8000, 97.8000, 98.8000, 99.8000, 100.8000, 101.8000, 102.8000, 103.8000, 104.8000, 105.8000, 107.0000, 108.0000, 109.0000, 110.0000,
                              111.0000, 112.0000, 113.0000, 114.0000, 115.0000, 116.0000, 117.0000, 118.0000, 119.0000, 120.0000, 121.0000, 122.0000, 123.0000, 124.0000, 125.0000,
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                              4005.0000, 4005.8000, 4006.6001, 4007.0000, 4008.0000, 4008.8000, 4009.8000, 4010.3999, 4011.0000, 4012.0000, 4012.8000, 4013.6001, 4014.2000, 4015.0000, 4015.80
                            };

//---------------------------------------------------------------ADEQUAÇÃO DOS SMEs CAPTURADOS DO MYOWARE-------------------------------------------------------------
// Os pinos do ESP32 podem trabalhar com até 3,3 V de saída. E a resolução A/D do ESP32 é de 12 bits -> 2^12 = 4096 (0 à 4095).
// Quando os SMEs chegam em um pino definido como entrada (aqui, GPIO 32) eles são convertidos em um valor respectivo entre 0 à 4095.
// Mas precisamos processasr os SMEs no seu valor de tensão capturado na superfície eletrolítica dos eletrodos.
// Dessa forma, é necessário adequar esse valor para obter o valor em milivolts gerados na superfície da pele, no contato com os eletrodos passivos de gel.
// Essa conversão é realizada pela equação abaixo:
//     Vmv = ((Vad * 3,3 ) / 4095 )) * (1 / 201) - > ( Vad * 3,3 ) / (4095 * 201)
// onde,
// 3,3 é a tensão máxima de saída do ESP32;
// 4095 é o valor máximo da resolução de 12 bits dos ESP32;
// 1/201 é o valor de ganho da plataforma MyoWare, esse valor é constante pois o potenciometro ajustável não tem efeito no pino raw.
// Vad (valor A/D)é o valor proveniente do MyoWare, recebido no GPIO 32 configurado como entrada analógica;
// Vmv (valor milivolts) é o Vad convertido.
double constante = 4.009257741e-6; // Resolução do termo (3.3)/(4095 *(201), simplificando a equação para Vmv = Vad * constante.

//------------------------------------------------------------------------NORMALIZAÇÃO POR CVM------------------------------------------------------------------------
// Valor das CVMs retiradas dos conjunto de aprendizagem 1 à 4, e a média das quatro CVMs foi utilizada para normalização. Os dados são normalizados usando RMS/CVM e DASDV/CVM.
// Não é recomendado substituir este valor por um CVM que não esteja incluido no treino do classificador.
// 1/CVM = 2.782305249539014e+03
//--------------------------------------------------------------------VARIÁVEIS DO VOTO MAJORITÁRIO-------------------------------------------------------------------
// Os SMEs são processados em características que são discriminadas a partir da distância Mahalanobis.
// Para garantir que não houvesse uma grande quantidade de falsos positivos/negativos, foi aplicado como pós-processamento o voto majoritário.
// Ele guarda 3 classes recém processadas e determina qual ocorreu com maior frequência entre as três, enviando ao SRA a classe com maior ocorrência.
// Após o envio, as 3 classes são descartadas, e o STI guarda mais 3 novas classes processadas para a decisão por voto majoritário.
int MV[3]; // Vetor que guarda as classes processadas.
int u = 0; // Índice do vetor de voto majoritário.
int mvsum = 0; // Contador auxiliar para determinar qual classe ocorreu com maior frequência.

//----------------------------------------------------------------------------SERVIDOR BLE----------------------------------------------------------------------------
// Site para gerar UUIDs:
// https://www.uuidgenerator.net/
#define SERVICE_UUID        "f57b1135-8c51-4e7b-be18-07b9cfa1507a" // Endereço do servidor STI.
#define CHARACTERISTIC_UUID "ad87f04a-5075-4109-8b84-f0b1b8ed173f" // Endereço pelo qual os dados serão enviados.
BLECharacteristic *pCharacteristic; // Variável que guarda o dado a ser enviado.

//---------------------------------------------------------------------------------------------------SETUP---------------------------------------------------------------------------------------------------
void setup() {
  Serial.begin(115200); //
  Serial.println("Iniciando conexao BLE!");
  BLEDevice::init(""); // Inicia o BLE.
  Serial.println("Iniciada conexao BLE!");
  BLEServer *pServer = BLEDevice::createServer(); // Cria o servidor BLE.
  BLEService *pService = pServer->createService(SERVICE_UUID); // Coloca o endereço no servidor.
  pCharacteristic = pService->createCharacteristic( // Cria o canal para envio dos dados no endereço especificado.
                      CHARACTERISTIC_UUID,
                      BLECharacteristic::PROPERTY_READ | // Permite o servidor receber dados.
                      BLECharacteristic::PROPERTY_WRITE // Permite o servidor enviar dados.
                    );
  pService->start(); // Roda o servidor.
  pCharacteristic->setValue("Testando envio");
  Serial.println("Aguardando algum dispositivo conectar...");
  BLEAdvertising *pAdvertising = BLEDevice::getAdvertising();
  pAdvertising->addServiceUUID(SERVICE_UUID); // Adiciona o endereço do servidor.
  pAdvertising->setScanResponse(true); // Permite ser encontrado por um scanner.
  pAdvertising->setMinPreferred(0x06);
  pAdvertising->setMinPreferred(0x12);
  BLEDevice::startAdvertising(); // Anuncia o servidor.
  Serial.println("Servidor STI rodando, iniciando envio da classe.");
}

//---------------------------------------------------------------------------------------------------LOOP---------------------------------------------------------------------------------------------------
void loop() {
  janelamento();
  filtro_bn();
  extracao();
  classificar();
}

void janelamento() {
  for (int w = 0; w < 80; w++) { // Segmenta os dados SMEs em tempo real em uma janela de 80 ms.
    x[t] = double(ADC_LUT[analogRead(32)] * constante); // Interpola os dados lidos no GPIO32 com os da LUT.
    delayMicroseconds(1000); // Delay para garantir leituras em 1 kHz.
    t++;
  }
}

void filtro_bn() {
  t = 0;
  n = 0;
  flag_reset = 0;
  dasdv_sum = 0; // Variável auxiliar usado na extração da característica DASDV.
  rms_sum = 0; // Variável auxiliar usado na extração da característica RMS.
  bn_cont = 0;
  for (int index = 0; index < 80; index++) { // Realiza a filtragem da janela de 0 à 79 amostras (80 amostras) dos SMEs. Cada amostra é coleta à 1 kHz, portanto é uma janela de 80 ms.
    if (bn_ant == false) { // Move a janela de SMEs capturados do MyoWare, se for a primeira filtragem após o início de STI.
      x_t1 = x[t - 1]; // Pega o dado da amostra SMEs da janela anterior x(79-1) para manter o filtro estável.
      if (t - 1 < 0 )x_t1 = 0; // Se o índice de x(t-1) for menor que 0, então o valor da amostra é 0. Essa condição é aplicada quando STI foi iniciado, e é a primeira vez que executa essa rotina. Não sendo o caso, o valor de x(t-1) continua como no comando anterior à este.
      x_t2 = x[t - 2];
      if (t - 2 < 0 )x_t2 = 0;
      x_t3 = x[t - 3];
      if (t - 3 < 0 )x_t3 = 0;
      x_t4 = x[t - 4];
      if (t - 4 < 0 )x_t4 = 0;
      Yc_n1 = Yc[n - 1];
      if (n - 1 < 0 & flag_reset == 0)Yc_n1 = 0;
      Yc_n2 = Yc[n - 2];
      if (n - 2 < 0 & flag_reset == 0)Yc_n2 = 0;
      if (flag_reset == 2) { // A segunda etapa utiliza um recurso antes do reset e um recurso recém processado pelo filtro. Essa etapa é um intermédio antes do filtro voltar a utilizar o vetor normalmente até o índice limite.
        Yc_n2 = Yc_n1_reset; // [-,-,n-2,n-1,-]
        Yc_n1 = Yc[n - 1]; // [-,-,n-2,n-1,n]
        flag_reset = 0; // Continua a deslocar permitindo novos recursos ocuparem o vetor e serem utilizados pelo filtro, ou seja, n-2 e n-1 já podem ser descartados.
      }
      if (flag_reset == 1) { // Houve o reset do vetor Yc. A última posição do vetor é alocada na primeira, e a penúltima na segunda. Isso é necessário devido a característica recursiva do filtro.
        Yc_n1 = Yc_n1_reset; // [-,-,-,-,n-1]
        Yc_n2 = Yc_n2_reset; // [-,-,-,n-2,n-1]
        flag_reset = 2;
      }
    }
    if (bn_ant == true) { // Se houver uma janela anterior filtrada, os dados SMEs do MyoWare da janela anterior e os dados filtrados pelo Butterworth+Notch são resgatados, pois o filtro é recursivo.
      if (bn_cont > 0 & bn_cont < 4) { // Isso é realizado 3 vezes (a primeira é realizado na condição else if abaixo) para mover as informações da janela filtrada anterior completamente para a nova janela filtrada.
        x_t4 = x_t3; // x[t-4] recebe x[t-3] (anterior), i.e., a janela desloca uma unidade na janela filtrada anterior.
        x_t3 = x_t2; // x[t-3] recebe x[t-2] (anterior), i.e., a janela desloca uma unidade na janela filtrada anterior.
        x_t2 = x_t1; // x[t-2] recebe x[t-1] (anterior), i.e., a janela desloca uma unidade na janela filtrada anterior.
        x_t1 = x[t - 1]; // x[t-1] recebe x[t-1], i.e., a janela desloca uma unidade na janela filtrada atual.
        Yc_n2 = Yc_n1; // Yc[n-2] recebe Yc[n-1] (anterior), i.e., a janela desloca uma unidade na janela filtrada anterior.
        Yc_n1 = Yc[n - 1]; // Yc[n-1] recebe Yc[n-1], i.e., a janela desloca uma unidade na janela filtrada atual.
        bn_cont++; // Adiciona uma unidade no contador do translado de recursos da janela filtrada anterior para a atual.
      }
      else if (bn_cont == 0) { // Caso o filtro esteja na primeira amostra da nova janela de SMEs, resgata também os SMEs filtrados no Butterworth passa-alta e passa-baixa, além do Notch.
        x_t1 = x_ant; // x[t-1] recebe x[79] da janela filtrada anteriormente.
        x_t2 = x_t1_ant; // x[t-2] recebe x[78] da janela filtrada anteriormente.
        x_t3 = x_t2_ant; // x[t-3] recebe x[77] da janela filtrada anteriormente.
        x_t4 = x_t3_ant; // x[t-4] recebe x[76] da janela filtrada anteriormente.
        Ya[1] = Ya_ant; // Ya[1] recebe Ya[0] da janela filtrada anteriormente.
        Ya[2] = Ya_n1_ant; // Ya[2] recebe Ya[1] da janela filtrada anteriormente.
        Ya[3] = Ya_n2_ant; // Ya[3] recebe Ya[2] da janela filtrada anteriormente.
        Ya[4] = Ya_n3_ant; // Ya[4] recebe Ya[3] da janela filtrada anteriormente.
        Yb[1] = Yb_ant; // Yb[1] recebe Yb[0] da janela filtrada anteriormente.
        Yb[2] = Yb_n1_ant; // Yb[2] recebe Yb[1] da janela filtrada anteriormente.
        Yb[3] = Yb_n2_ant; // Yb[3] recebe Yb[2] da janela filtrada anteriormente.
        Yb[4] = Yb_n3_ant; // Yb[4] recebe Yb[3] da janela filtrada anteriormente.
        Yc_n1 = Yc_ant; // Yc[n-1] recebe Yc[n] da janela filtrada anteriormente.
        Yc_n2 = Yc_n1_ant; // Yc[n-2] recebe Yc[n-1] da janela filtrada anteriormente.
        bn_cont++; // Adiciona uma unidade no contador do translado de recursos da janela filtrada anterior para a atual.
      }
    }
    if (bn_cont >= 4) { // A partir da 4ª vez movendo os dados da janela filtrada anterior, o filtro estabiliza e pode usar o método inicial para deslocar o vetor que guarda os SMEs filtrados.
      bn_ant = false; // Dados filtrados da janela anterior incorporados na filtragem da janela atual, desativando deslocamento com os recursos da janela anterior.
    }
    Ya[0] = Ba[0] * x[t] + Ba[1] * x_t1 + Ba[2] * x_t2 + Ba[3] * x_t3 + Ba[4] * x_t4 - Aa[1] * Ya[1] - Aa[2] * Ya[2] - Aa[3] * Ya[3] - Aa[4] * Ya[4]; // Butterworth passa-alta
    Yb[0] = Bb[0] * Ya[0] + Bb[1] * Ya[1] + Bb[2] * Ya[2] + Bb[3] * Ya[3] + Bb[4] * Ya[4] - Ab[1] * Yb[1] - Ab[2] * Yb[2] - Ab[3] * Yb[3] - Ab[4] * Yb[4]; // Butterworth passa-baixa
    Yc[n] = Bn[0] * Yb[0] + Bn[1] * Yb[1] + Bn[2] * Yb[2] - An[1] * Yc_n1 - An[2] * Yc_n2;  // Notch 60 Hz
    
    // Features
    rms_sum += Yc[n] * Yc[n]; // Variável da auxiliar característica RMS para ser utilizada na rotina de extração.

    if (index > 0 && index < 79) { // Se não for a última amostra da janela, continua processando os dados para extração de DASDV.
      // Para implementar a DASDV em tempo real é necessário fazer um pequeno deslocamento de 1 unidade no index, visto que a leitura Yc[n + 1] ainda não foi realizada.
      // Assim, é realizado uma operação ao fim da rotina de filtragem para coletar o ultimo valor de Yc para extração.
      dasdv_aux = (Yc[n] - Yc[n - 1]); // Variável auxiliar da característica DASDV para ser utilizada na rotina de extração. 1/80-1 = 0.01265822785 | Janela disruptiva de 80 ms.
      dasdv_sum += dasdv_aux * dasdv_aux; // Outra variável auxiliar da característica DASDV.
    } 
    // Como o filtro é recursivo ele utiliza as saídas anteriores como entradas para equação do filtro. No entanto, os dados das janelas anteriores são descartados após a filtragem, os recursos de saída precisam ser salvos para serem utilizados na próxima janelas a ser filtrada.
    // Então, são salvos os recursos necessário nesta rotina. Estes recursos são implementados no ínicio da filtragem da próxima janela de SMEs.
    else if (index == 79) { // Se for a última amostra da janela: 
      // Computa ultima soma para a extração de DASDV.
      dasdv_aux = (Yc[n] - Yc[n - 1]);
      dasdv_sum += dasdv_aux * dasdv_aux;
      delay(1);
      // Os dados das ultimas amostras serão guardados para a filtragem na nova janela a ser capturada. Alocam os recursos da janela filtrada anterior.
      x_ant = x[79]; // Salva o dado da amostra 79 (pos. 80) para ser utilizada como recurso na nova janela de dados SMEs a ser filtrada.
      x_t1_ant = x[78]; // Salva o dado da amostra 78 (pos. 79) para ser utilizada como recurso na nova janela de dados SMEs a ser filtrada.
      x_t2_ant = x[77]; // Salva o dado da amostra 77 (pos. 78) para ser utilizada como recurso na nova janela de dados SMEs a ser filtrada.
      x_t3_ant = x[76]; // Salva o dado da amostra 76 (pos. 77) para ser utilizada como recurso na nova janela de dados SMEs a ser filtrada.
      Ya_ant = Ya[0]; // Salva o dado da amostra filtrada Ya[0] para ser utilizada como recurso na nova janela de dados SMEs a ser filtrada.
      Ya_n1_ant = Ya[1]; // Salva o dado da amostra filtrada Ya[1] para ser utilizada como recurso na nova janela de dados SMEs a ser filtrada.
      Ya_n2_ant = Ya[2]; // Salva o dado da amostra filtrada Ya[2] para ser utilizada como recurso na nova janela de dados SMEs a ser filtrada.
      Ya_n3_ant = Ya[3]; // Salva o dado da amostra filtrada Ya[3] para ser utilizada como recurso na nova janela de dados SMEs a ser filtrada.
      Yb_ant = Yb[0]; // Salva o dado da amostra filtrada Yb[0] para ser utilizada como recurso na nova janela de dados SMEs a ser filtrada.
      Yb_n1_ant = Yb[1]; // Salva o dado da amostra filtrada Yb[1] para ser utilizada como recurso na nova janela de dados SMEs a ser filtrada.
      Yb_n2_ant = Yb[2]; // Salva o dado da amostra filtrada Yb[2] para ser utilizada como recurso na nova janela de dados SMEs a ser filtrada.
      Yb_n3_ant = Yb[3]; // Salva o dado da amostra filtrada Yb[3] para ser utilizada como recurso na nova janela de dados SMEs a ser filtrada.
      Yc_ant = Yc[n]; // Salva o dado da amostra filtrada Yc[n] para ser utilizada como recurso na nova janela de dados SMEs a ser filtrada.
      Yc_n1_ant = Yc[n - 1]; // Salva o dado da amostra filtrada Yc[n-1] para ser utilizada como recurso na nova janela de dados SMEs a ser filtrada.
    }
    // Janela móvel desloca uma unidade para frente na janela de amostras SMEs sendo filtrados. Deslocamento dos recursos da janela atual sendo filtrada.
    Ya[4] = Ya[3];
    Ya[3] = Ya[2];
    Ya[2] = Ya[1];
    Ya[1] = Ya[0];
    Yb[4] = Yb[3];
    Yb[3] = Yb[2];
    Yb[2] = Yb[1];
    Yb[1] = Yb[0];
    if (n >= 4) { // O vetor Yc também é um vetor móvel e possui 5 (0~4) posições. A partir da última posição ele precisa ser resetado para começar a gravar os dados de novo.
      n++;
      Yc_n1_reset = Yc[n - 1]; // Esses dados são salvos porque são recursos que precisam ser utilizados pelo filtro [-,-,-,-,n-1]
      Yc_n2_reset = Yc[n - 2]; // Esses dados são salvos porque são recursos que precisam ser utilizados pelo filtro [-,-,-,n-2,n-1]
      n = 0; // Reseta o índice do vetor Yc.
      flag_reset = 1; // Ativa a rotina para utilizar esses recursos salvos no filtro.
    }
    else n++; // Se n não for 4 ou maior que 4, então acrescenta uma unidade no índice do vetor do filtro Yc.
    t++; // Acrescenta uma unidade no índice da janela de amostras de SMEs, i.e., x[n]
  }
  bn_ant = true;
  t = 0; // Reseta o índice da janela de amostras de SMEs, i.e., x[n]
}

void extracao() {
  // Extrai as features do sinal filtrado (Yc[n]) na etapa anterior.
  // RMS: ((sum(Yc[n]^2))/80)/CVM | CVM -> Contração Voluntária Máxima para normalização. i: 1 -> n
  x_carac[0][0] = sqrt((rms_sum * 0.0125)) * 2.782305249539014e+03; // 1/79 = 0.01265822785
  // DASDV: sqrt((sum(Yc[n+1] - Yc[n])^2)/79)/CVM | CVM -> Contração Voluntária Máxima para normalização. i: 1 -> n-1
  x_carac[0][1] = sqrt((dasdv_sum * 0.01265822785)) * 2.782305249539014e+03;
}

void classificar() {
  // A equação é dividia em duas partes:
  // x_m_Sinv = (x - m) * S^-1
  // y = x_m_Sinv * (x - m)'

  // Classe MR
  // x_m_Sinv = (x - m) * S^-1
  x_m_Sinv[0][0] = ((x_carac[0][0] - m[0][0]) * Sinv[0][0]) + ((x_carac[0][1] - m[0][1]) * Sinv[1][0]); // Se utilizar 3 ou mais características, deve-se adicionar para cada: + ((x_carac[0][n+1] - m[0][n+1]) * Sinv[n+1][0]);
  x_m_Sinv[0][1] = ((x_carac[0][0] - m[0][0]) * Sinv[0][1]) + ((x_carac[0][1] - m[0][1]) * Sinv[1][1]); // Se utilizar 3 ou mais características, deve-se adicionar para cada: + ((x_carac[0][2] - m[0][2]) * Sinv[2][1]);

  // y = x_m_Sinv * (x - m)'
  // Distância Mahalanobis para a classe MR
  y[0][0] = (x_m_Sinv[0][0] * (x_carac[0][0] - m[0][0])) + (x_m_Sinv[0][1] * (x_carac[0][1] - m[0][1])); // Se utilizar 3 ou mais características, deve-se adicionar para cada: + (x_m_Sinv[0][n+1] * (x[0][n+1] - m[0][n+1]));

  // Classe PP
  // x_m_Sinv = (x - m) * S^-1
  x_m_Sinv[1][0] = ((x_carac[0][0] - m[1][0]) * Sinv[0][0]) + ((x_carac[0][1] - m[1][1]) * Sinv[1][0]); // Se utilizar 3 ou mais características, deve-se adicionar para cada: + ((x_carac[0][n+1] - m[1][n+1]) * Sinv[n+1][0]);
  x_m_Sinv[1][1] = ((x_carac[0][0] - m[1][0]) * Sinv[0][1]) + ((x_carac[0][1] - m[1][1]) * Sinv[1][1]);// Se utilizar 3 ou mais características, deve-se adicionar para cada: + ((x_carac[0][2] - m[1][2]) * Sinv[2][1]);

  // y = x_m_Sinv * (x - m)'
  // Distância Mahalanobis para a classe PP
  y[0][1] = (x_m_Sinv[1][0] * (x_carac[0][0] - m[1][0])) + (x_m_Sinv[1][1] * (x_carac[0][1] - m[1][1])); // Se utilizar 3 ou mais características, deve-se adicionar para cada: + (x_m_Sinv[1][n+1] * (x[0][n+1] - m[1][n+1]));

  // Classe PC
  // x_m_Sinv = (x - m) * S^-1
  x_m_Sinv[2][0] = ((x_carac[0][0] - m[2][0]) * Sinv[0][0]) + ((x_carac[0][1] - m[2][1]) * Sinv[1][0]); // Se utilizar 3 ou mais características, deve-se adicionar para cada: + ((x_carac[0][n+1] - m[2][n+1]) * Sinv[n+1][0]);
  x_m_Sinv[2][1] = ((x_carac[0][0] - m[2][0]) * Sinv[0][1]) + ((x_carac[0][1] - m[2][1]) * Sinv[1][1]); // Se utilizar 3 ou mais características, deve-se adicionar para cada: + ((x_carac[0][2] - m[2][2]) * Sinv[2][1]);

  // y = x_m_Sinv * (x - m)'
  // Distância Mahalanobis para a classe PC
  y[0][2] = (x_m_Sinv[2][0] * (x_carac[0][0] - m[2][0])) + (x_m_Sinv[2][1] * (x_carac[0][1] - m[2][1])); //  Se utilizar 3 ou mais características, deve-se adicionar para cada: + (x_m_Sinv[2][n+1] * (x_carac[0][n+1] - m[2][n+1]));

  // Discriminação
  if (y[0][0] < y[0][1] & y[0][0] < y[0][2]) MV[u] = 1; // Verifica qual distância é menor, se MR tiver a menor distância até x, atribui ao índice u do vetor MV o valor 1.
  else if (y[0][1] < y[0][0] & y[0][1] < y[0][2]) MV[u] = 4; // Verifica qual distância é menor, se PP tiver a menor distância até x, atribui ao índice u do vetor MV o valor 4.
  else if (y[0][2] < y[0][0] & y[0][2] < y[0][1]) MV[u] = 13; // Verifica qual distância é menor, se PC tiver a menor distância até x, atribui ao índice u do vetor MV o valor 13.
  u++; // Acrescenta uma unidade ao índice de MV

  // Voto majoritário
  if (u > 2) { // Se o índice alcançar o valor 3, significa que já preencheu o vetor com 3 classes.
    mvsum = MV[0] + MV[1] + MV[2]; // Soma os valores
    if (mvsum == 3 || mvsum == 6 || mvsum == 15) pCharacteristic->setValue("MR"); // A soma representa uma das possibilidades de MR ter maior ocorrência, onde c representa 1, 4 ou 13:
    // [1,1,1] || [1,1,c] || [1,c,1] || [c,1,1]. Portanto, transmite a classe MR para SRA
    else if (mvsum == 9 || mvsum == 12 || mvsum == 21) pCharacteristic->setValue("PP"); // A soma representa uma das possibilidades de PP ter maior ocorrência:
    // [4,4,4] || [4,4,c] || [4,c,4] || [c,4,4]. Portanto, transmite a classe MR para SRA
    else if (mvsum == 27 || mvsum == 30 || mvsum == 39) pCharacteristic->setValue("PC"); // A soma representa uma das possibilidades de PC ter maior ocorrência:
    // [13,13,13] || [13,13,c] || [13,c,13] || [c,13,13]. Portanto, transmite a classe MR para SRA
    u = 0; // Reinicia o índice para novas 3 classes.
  }
}
